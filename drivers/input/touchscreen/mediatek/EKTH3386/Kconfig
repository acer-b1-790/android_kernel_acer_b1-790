## drivers/input/touchscreen/mediatek/EKTH3386/Kconfig
```kconfig
#
# Touchscreen driver configuration
#
if TOUCHSCREEN_MTK_EKTH3386

config EKTH3386_CONFIG
	string "EKTH3386 for Mediatek config"

endif
```
